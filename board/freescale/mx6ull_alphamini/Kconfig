## board/freescale/mx6ull_alphamini/Kconfig
```kconfig
if TARGET_MX6ULL_ALPHAMINI

config SYS_BOARD
	default "mx6ull_alphamini"

config SYS_VENDOR
	default "freescale"

config SYS_CONFIG_NAME
	default "mx6ull_alphamini"

config IMX_CONFIG
	default "board/freescale/mx6ull_alphamini/imximage.cfg"

config SYS_TEXT_BASE
	default 0x87800000
endif
```
